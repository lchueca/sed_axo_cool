## sdkconfig.defaults
```kconfig
# Configuración de la Flash
CONFIG_ESPTOOLPY_FLASHSIZE_4MB=y
CONFIG_ESPTOOLPY_FLASHSIZE="4MB"

# Bootloader Rollback 
CONFIG_BOOTLOADER_APP_ROLLBACK_ENABLE=y

# Tabla de Particiones Personalizada
CONFIG_PARTITION_TABLE_CUSTOM=y
CONFIG_PARTITION_TABLE_CUSTOM_FILENAME="../partitions.csv"
CONFIG_PARTITION_TABLE_FILENAME="../partitions.csv"

# TLS
CONFIG_ESP_TLS_INSECURE=y
CONFIG_ESP_TLS_SKIP_SERVER_CERT_VERIFY=y
CONFIG_ESP_TLS_ALLOW_HTTP_INSECURE_OPTIONS=y
CONFIG_ESP_TLS_SKIP_SERVER_CERT_VERIFY=y
```
